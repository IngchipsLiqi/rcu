
/*
** COPYRIGHT (c) 2023 by INGCHIPS
*/

#include <stdio.h>

#include "FreeRTOS.h"
#include "semphr.h"

#include "ingsoc.h"
#include "platform_api.h"

#include "profile.h"
#include "pingpong.h"
#include "audio_service.h"
#include "audio_denoise.h"

#if defined __cplusplus
    extern "C" {
#endif

// const static unsigned char audio_input_sim_data[][SAMPLE_BUF_8BIT_LEN] = {
//     {0x00, 0x00, 0x00, 0x00, 0xff, 0xff, 0x00, 0x00, 0x00, 0x00, 0x00, 0x00, 0x00,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 0x00, 0x00},
//     {0x00, 0x00, 0x00, 0x00, 0x00, 0x00, 0x00, 0x00, 0x00, 0x00, 0x00, 0x01, 0x00,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 0x00, 0x00},
//     {0x00, 0x00, 0x00, 0x00, 0x00, 0x00, 0xff, 0xff, 0x00, 0x00, 0xff, 0xff, 0x00,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 0x00, 0x02},
//     {0x00, 0x01, 0x00, 0x01, 0x00, 0x00, 0x00, 0x01, 0x00, 0x01, 0x00, 0x00, 0x00,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 0x00, 0x00},
//     {0x00, 0x00, 0x00, 0x00, 0xff, 0xff, 0x00, 0x00, 0x00, 0x00, 0x00, 0x00, 0x00,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 0x00, 0x00},
// };

// const static unsigned char audio_input_sim_data[][SAMPLE_BUF_8BIT_LEN] = {
//     #include "../../data/16k_16bit_input.m"
// };

#define RAW_16K_16BIT_DATA_LEN         140480
static uint8_t *audio_input_sim_data = (uint8_t *)RAW_16K_16BIT_DATA_POSITION;
static int audio_input_sim_data_index = 0;
static int16_t audio_input_sim_data_read(void)
{
    int16_t sample_data;

    sample_data = audio_input_sim_data[audio_input_sim_data_index + 1];
    sample_data = (sample_data << 8) | audio_input_sim_data[audio_input_sim_data_index];

    audio_input_sim_data_index += 2;
    if (audio_input_sim_data_index >= RAW_16K_16BIT_DATA_LEN) {
        audio_input_sim_data_index = 0;
    }
    return sample_data;
}

static uint16_t uint16_revert_byte(uint16_t data)
{
    uint16_t ret;
    ret = (data >> 8) | (data << 8);
    return ret;
}

uint16_t g_sample_rate = 16000;

#define ADC_CHANNEL              ADC_CH_0
#define DMA_CHANNEL              0
#define ADC_CLK_MHZ              6
#define AUDIO_ADC_SAMPLE_MODE    DIFFERENTAIL_MODE
#define LOOP_DELAY(c, s)         (((c) / (s)) - (21))
#define MULTI_SAMPLE_NUM         2

static DMA_PingPong_t PingPong;
static uint32_t DMA_cb_isr(void *user_data)
{
    static uint16_t multi_sample_sum = 0;
    static uint8_t multi_sample_cnt = 0;
    uint32_t state = DMA_GetChannelIntState(DMA_CHANNEL);

    DMA_ClearChannelIntState(DMA_CHANNEL, state);

    uint32_t *buff = DMA_PingPongIntProc(&PingPong, DMA_CHANNEL);
    uint32_t tranSize = DMA_PingPongGetTransSize(&PingPong);

    for (uint32_t i = 0; i < tranSize; ++i) {
        if (ADC_GetDataChannel(buff[i]) != ADC_CHANNEL) {
            continue;
        }
        uint16_t sample = buff[i] & 0x3FFF;

        multi_sample_sum += sample;
        multi_sample_cnt++;
        if (multi_sample_cnt >= MULTI_SAMPLE_NUM) {
            uint8_t temp_data = 0;
            sample = multi_sample_sum / MULTI_SAMPLE_NUM;
            sample = sample - 0x2000;
            sample = sample * 8;

            sample = uint16_revert_byte(sample);

//            sample = audio_input_sim_data_read(); // AUDIO_TEST
//            sample = uint16_revert_byte(sample);
//            temp_data = sample;
//            while (apUART_Check_TXFIFO_FULL(APB_UART0) == 1);
//            UART_SendData(APB_UART0, temp_data);
//            temp_data = sample >> 8;
//            while (apUART_Check_TXFIFO_FULL(APB_UART0) == 1);
//            UART_SendData(APB_UART0, temp_data);

            audio_rx_sample(sample);

            multi_sample_sum = 0;
            multi_sample_cnt = 0;
        }
    }
    return 0;
}

void audio_adc_input_setup(void)
{
    log_printf("[>i:audio] input setup\n");
    SYSCTRL_ClearClkGateMulti((1 << SYSCTRL_ITEM_APB_DMA));

    SYSCTRL_ClearClkGate(SYSCTRL_ITEM_APB_ADC);
    SYSCTRL_SetAdcClkDiv(24 / ADC_CLK_MHZ);
    //SYSCTRL_SetAdcClkDiv(0x3f);
    SYSCTRL_ReleaseBlock(SYSCTRL_ITEM_APB_ADC);
    ADC_Reset();
    ADC_ftInit();
    ADC_Calibration(AUDIO_ADC_SAMPLE_MODE);
    ADC_ConvCfg(CONTINUES_MODE, PGA_PARA_5, 1, ADC_CHANNEL, 0, 8, AUDIO_ADC_SAMPLE_MODE, 
        LOOP_DELAY(((ADC_CLK_MHZ) * (1000000)), (g_sample_rate * MULTI_SAMPLE_NUM)));
        //LOOP_DELAY((24000000 / 0x3f), (g_sample_rate * MULTI_SAMPLE_NUM)));

    SYSCTRL_SelectUsedDmaItems(1 << 9);
    DMA_PingPongSetup(&PingPong, SYSCTRL_DMA_ADC, 80, 8);
    platform_set_irq_callback(PLATFORM_CB_IRQ_DMA, DMA_cb_isr, 0);
}

void audio_adc_input_start(void)
{
    log_printf("[>i:audio] input start\n");
    audio_denoise_init(g_sample_rate);
    DMA_PingPongEnable(&PingPong, DMA_CHANNEL);
    ADC_Start(1);
    audio_input_sim_data_index = 0;
}

void audio_adc_input_stop(void)
{
    log_printf("[>i:audio] input stop\n");
    ADC_Start(0);
    DMA_PingPongDisable(&PingPong, DMA_CHANNEL);
}

static int16_t audio_denoise_process_buf[AUDIO_DENOISE_HOP_LEN] = {0};
static int audio_denoise_process_buf_index = 0;

static int16_t audio_input_agc(int16_t data)
{
    return data;
}
void audio_adc_agc_denoise_coded_test(void)
{
    int16_t sample;
    uint8_t temp_data;
    int out_index;
    int16_t out_data;

    if (audio_denoise_init(g_sample_rate) != 0) {
        while (1) {};
    }

    audio_input_sim_data_index = 0;
    do {
        // sample = audio_input_sim_data_read(); // AUDIO_TEST
        //platform_printf("%d ", sample);
        sample = audio_input_agc(sample);

        audio_denoise_process_buf[audio_denoise_process_buf_index] = sample;
        audio_denoise_process_buf_index++;
        if (audio_denoise_process_buf_index >= AUDIO_DENOISE_HOP_LEN) {
            audio_denoise_process_buf_index = 0;
            if(audio_denoise_process(audio_denoise_process_buf, audio_denoise_process_buf) == 0) {
                for (out_index = 0; out_index < AUDIO_DENOISE_HOP_LEN; out_index++) {
                    out_data = audio_denoise_process_buf[out_index];
                    //platform_printf("%d ", out_data);

                    temp_data = out_data;
                    while (apUART_Check_TXFIFO_FULL(APB_UART0) == 1);
                    UART_SendData(APB_UART0, temp_data);
                    temp_data = out_data >> 8;
                    while (apUART_Check_TXFIFO_FULL(APB_UART0) == 1);
                    UART_SendData(APB_UART0, temp_data);
                }
            }
        }
    } while (audio_input_sim_data_index != 0);
    while (1) {};
}

#if defined __cplusplus
    }
#endif
